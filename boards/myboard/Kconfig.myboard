## boards/myboard/Kconfig.myboard
```kconfig
# Copyright (c) 2026 Lennart Rittel <lrittel@posteo.de>
# SPDX-License-Identifier: Apache-2.0

config BOARD_MYBOARD
	select SOC_STM32G491XX
```

## boards/myboard/board.yml
```yaml
board:
  name: myboard
  full_name: My Custom Board
  vendor: st
  socs:
    - name: stm32g491xx
```

## drivers/our_driver/Kconfig
```kconfig
config OUR_DRIVER
	bool "Enable Our Driver"
	default y
	depends on DT_HAS_OUR_DRIVER_ENABLED
	depends on SENSOR
	select GPIO
	help
	  Enable our simple LED driver.
```

## dts/bindings/our,driver.yaml
```yaml
description: Our driver binding
compatible: "our,driver"
include: base.yaml

properties:
    led:
        type: phandle
        required: true
```

## twister-out.2/native_sim_native/host_gnu/zephyr-course-dio/tests/ring_buf/homework.unit.ring_buf/Kconfig/boards/Kconfig.native_sim
```kconfig
# Load board Kconfig descriptions.
osource "/home/Orion/zephyrproject/zephyr/boards/native/native_sim/Kconfig.native_sim"
```

## twister-out.3/native_sim_native/host_gnu/zephyr-course-dio/tests/ring_buf/homework.unit.ring_buf/Kconfig/boards/Kconfig.sysbuild
```kconfig
# Load Sysbuild board Kconfig descriptions.
osource "/home/Orion/zephyrproject/zephyr/boards/native/native_sim/Kconfig.sysbuild"
```

## twister-out.5/native_sim_native/host_gnu/zephyr-course-dio/tests/ring_buf/homework.unit.ring_buf/Kconfig/boards/Kconfig
```kconfig
# Load Zephyr board Kconfig descriptions.
osource "/home/Orion/zephyrproject/zephyr/boards/native/native_sim/Kconfig"
```

## twister-out/native_sim_native/host_gnu/zephyr-course-dio/tests/ring_buf/homework.unit.ring_buf/Kconfig/arch/Kconfig
```kconfig
# Load Zephyr Arch Kconfig descriptions.
osource "/home/Orion/zephyrproject/zephyr/arch/tricore/Kconfig"
osource "/home/Orion/zephyrproject/zephyr/arch/hexagon/Kconfig"
osource "/home/Orion/zephyrproject/zephyr/arch/rx/Kconfig"
osource "/home/Orion/zephyrproject/zephyr/arch/x86/Kconfig"
osource "/home/Orion/zephyrproject/zephyr/arch/xtensa/Kconfig"
osource "/home/Orion/zephyrproject/zephyr/arch/sparc/Kconfig"
osource "/home/Orion/zephyrproject/zephyr/arch/riscv/Kconfig"
osource "/home/Orion/zephyrproject/zephyr/arch/posix/Kconfig"
osource "/home/Orion/zephyrproject/zephyr/arch/openrisc/Kconfig"
osource "/home/Orion/zephyrproject/zephyr/arch/mips/Kconfig"
osource "/home/Orion/zephyrproject/zephyr/arch/arm64/Kconfig"
osource "/home/Orion/zephyrproject/zephyr/arch/arm/Kconfig"
osource "/home/Orion/zephyrproject/zephyr/arch/arc/Kconfig"
```
